## config/boards/shields/Yarisugi/Kconfig.defconfig
```kconfig
if SHIELD_YARISUGI_LEFT

config ZMK_KEYBOARD_NAME
    default "Yarisugi"

config ZMK_SPLIT_ROLE_CENTRAL
    default y

endif

if SHIELD_YARISUGI_LEFT || SHIELD_YARISUGI_RIGHT

config ZMK_SPLIT
    default y

endif
```

## config/boards/shields/Yarisugi/Kconfig.shield
```kconfig
config SHIELD_YARISUGI_LEFT
    def_bool $(shields_list_contains,Yarisugi_left)

config SHIELD_YARISUGI_RIGHT
    def_bool $(shields_list_contains,Yarisugi_right)
```
